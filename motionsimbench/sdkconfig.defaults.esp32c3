## motionsimbench/sdkconfig.defaults.esp32c3
```kconfig
# sdkconfig.defaults.esp32c3
# Applied automatically by IDF when IDF_TARGET=esp32c3

CONFIG_ESP_CONSOLE_UART_DEFAULT=y
CONFIG_ESP_CONSOLE_UART_NUM=0

CONFIG_ESPTOOLPY_FLASHSIZE_4MB=y
CONFIG_ESPTOOLPY_FLASHSIZE="4MB"

CONFIG_PARTITION_TABLE_CUSTOM_FILENAME="partitions_ota_4mb.csv"
CONFIG_PARTITION_TABLE_FILENAME="partitions_ota_4mb.csv"

# Enable Info log level for diagnostics
CONFIG_LOG_DEFAULT_LEVEL_INFO=y
CONFIG_LOG_MAXIMUM_LEVEL_INFO=y

CONFIG_LWIP_TCPIP_TASK_STACK_SIZE=3072

CONFIG_ESP_WIFI_AMPDU_RX_ENABLED=n
CONFIG_ESP_WIFI_AMPDU_TX_ENABLED=n

CONFIG_HTTPD_MAX_REQ_HDR_LEN=512
CONFIG_HTTPD_MAX_URI_LEN=512
CONFIG_HTTPD_WS_SUPPORT=n

CONFIG_ESP_COREDUMP_ENABLE_TO_NONE=y
```

## motionsimbot/sdkconfig.defaults
```kconfig
CONFIG_PARTITION_TABLE_CUSTOM=y
CONFIG_PARTITION_TABLE_CUSTOM_FILENAME="partitions_ota_4mb.csv"
CONFIG_PARTITION_TABLE_FILENAME="partitions_ota_4mb.csv"
CONFIG_ESPTOOLPY_FLASHSIZE_4MB=y
CONFIG_ESPTOOLPY_FLASHSIZE="4MB"
CONFIG_HTTPD_MAX_REQ_HDR_LEN=512
CONFIG_FREERTOS_HZ=1000
```
